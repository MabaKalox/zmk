## app/boards/shields/ergodone/Kconfig.defconfig
```kconfig
# Copyright (c) 2020 The ZMK Contributors
# SPDX-License-Identifier: MIT

if SHIELD_ERGODONE

config ZMK_KEYBOARD_NAME
    default "Ergodone"

config I2C
    default y

config ZMK_KSCAN_MATRIX_POLLING
    default y

config GPIO_MCP230XX
    default y

endif
```

## app/boards/shields/ergodone/Kconfig.shield
```kconfig
# Copyright (c) 2020 The ZMK Contributors
# SPDX-License-Identifier: MIT

config SHIELD_ERGODONE
    def_bool $(shields_list_contains,ergodone)
```
